## drivers/cpufreq/Kconfig.default_governor
```kconfig
config CPU_FREQ_DEFAULT_GOV_SMARTASS2
        bool "smartass2"
        select CPU_FREQ_GOV_SMARTASS2
        help
          Use the CPUFreq governor 'smartassV2' as default.

config CPU_FREQ_DEFAULT_GOV_WHEATLEY
	bool "wheatley"
	select CPU_FREQ_GOV_WHEATLEY
	select CPU_FREQ_GOV_PERFORMANCE
	help
          Use the CPUFreq governor 'wheatley' as default.
```

## drivers/cpufreq/Kconfig.governors
```kconfig
config CPU_FREQ_GOV_SMARTASS2
	tristate "'smartassV2' cpufreq governor"
	depends on CPU_FREQ
	help
	SmartassV2 is a governor (controls the frequency of the 
	CPU at each give moment) which like the first smartass is 
	generally based on the implementation of interactive with
	some major changes and the addition of a built in sleep
	profile (behaves a bit differently when screen is off vs. on).
	The smartassV2 improves the very naive scheme which the first
	smartass had

config CPU_FREQ_GOV_WHEATLEY
	tristate "'wheatley' cpufreq governor"
	depends on CPU_FREQ
     ---help---
	Building on the classic 'ondemand' governor is implemented Wheatley
	governor. The governor has two additional parameters that control
	the state.
```
